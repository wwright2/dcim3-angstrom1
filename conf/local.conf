## conf/local.conf
```bitbake
# CONF_VERSION is increased each time build/conf/ changes incompatibly
CONF_VERSION = "1"

INHERIT += "rm_work"

# Which files do we want to parse:
BBMASK = ""

# What kind of images do we want?
IMAGE_FSTYPES_append = " tar.xz"
IMAGE_FSTYPES_remove = "tar.gz"
IMAGE_FSTYPES_remove = "ubi"
IMAGE_FSTYPES_remove = "ubifs"

# Disable ISO image by default
NOISO = "1"

# Make use of SMP:
#   PARALLEL_MAKE specifies how many concurrent compiler threads are spawned per bitbake process
#   BB_NUMBER_THREADS specifies how many concurrent bitbake tasks will be run
PARALLEL_MAKE     = "-j8"
BB_NUMBER_THREADS = "8"


# To generate debug info for packages, you can add dbg-pkgs to 
# EXTRA_IMAGE_FEATURES in local.conf. For example:
# LIST:
#	dbg-pkgs: Installs debug symbol packages for all packages installed in a given image.
#    dev-pkgs: Installs development packages (headers and extra library links) for all packages installed in a given image.
#    doc-pkgs: Installs documentation packages for all packages installed in a given image.
       
DISTRO = "angstrom-v2014.12"

PREFERRED_PROVIDER_glibc = "glibc"
PREFERRED_PROVIDER_virtual/kernel = "linux-am335x-psp"


#### Does not seem to work i.e. remove systemd,   inittab etc.
#wwDISTRO_FEATURES_append = " sysvinit"
#ww VIRTUAL-RUNTIME_init_manager = " sysvinit "
#ww DISTRO_FEATURES_BACKFILL_CONSIDERED = "sysvinit"
#ww VIRTUAL-RUNTIME_initscripts = "initscripts"
#ww IMAGE_INSTALL_remove = " systemd "

#Valid features
# dbg-pkgs debug-tweaks dev-pkgs doc doc-pkgs package-management ptest-pkgs 
# qtcreator-debug read-only-rootfs splash staticdev-pkgs
# eclipse-debug hwcodecs nfs-server package-management ptest-pkgs qt4-pkgs 
# ssh-server-dropbear ssh-server-openssh staticdev-pkgs 
# tools-debug tools-profile tools-sdk tools-testapps 
# x11 x11-base x11-sato

EXTRA_IMAGE_FEATURES = " debug-tweaks dev-pkgs "
EXTRA_IMAGE_FEATURES =+ " splash package-management "
#IMAGE_FEATURES += " ssh-server-dropbear "

IMAGE_INSTALL_append = " \
		sqlite3 redis ruby python db libpam monit \
		libv4l jpeg libyaml at init-ifupdown i2c-tools nginx \
		dhcp-client	\
		maxtouch 		\
		gstreamer1.0	\ 
		usbutils lsof	\
		x11-common xserver-xorg xserver-xorg-xvfb xf86-video-fbdev xserver-xorg-extension-glx xserver-xorg-module-libwfb lxdm xf86-input-evdev \
		chromium	\
		yavta media-ctl v4l-utils	\
		" 

# tools-sdk hwcodecs 
# libssp
# init-ifupdown sysvinit-inittab 
# packagegroup-core-buildessential	
# x11-common xserver-xorg xserver-xorg-xvfb xf86-video-fbdev xserver-xorg-extension-glx xserver-xorg-module-libwfb lxdm xf86-input-evdev  
# useradd-systemd-network

#By default, the Yocto build system strips symbols from the binaries it 
# packages, which makes it difficult to use some of the tools. 
#INHIBIT_PACKAGE_STRIP = "1"

# Set DEPLOY_DIR outside of TMPDIR

DEPLOY_DIR = "${TMPDIR}/../../deploy/${TCLIBC}"
# Don't generate the mirror tarball for SCM repos, the snapshot is enough
BB_GENERATE_MIRROR_TARBALLS = "0"

# Disable build time patch resolution. This would lauch a devshell
# and wait for manual intervention. We disable it.
PATCHRESOLVE = "noop"

#
# Shared-state files from other locations
#
# Shared state files are prebuilt cache data objects which can 
# used to accelerate build time. This variable can be used to configure the system
# to search other mirror locations for these objects before it builds the data itself.
#
# This can be a filesystem directory, or a remote url such as http or ftp. These
# would contain the sstate-cache results from previous builds (possibly from other 
# machines). This variable works like fetcher MIRRORS/PREMIRRORS and points to the 
# cache locations to check for the shared objects.
#SSTATE_MIRRORS ?= "\
#file://.* http://someserver.tld/share/sstate/ \n \
#file://.* file:///some/local/dir/sstate/"

#SSTATE_MIRRORS ?= "\
#file://.* http://dominion.thruhere.net/angstrom/sstate-mirror/ \n "

# enable PR service on build machine itself
# its good for a case when this is the only builder
# generating the feeds
#
PRSERV_HOST = "localhost:0"

#TCLIBC = "external-linaro-toolchain"
#TCMODE = "external-linaro"
#EXTERNAL_TOOLCHAIN = "/usr/local/arm-linux-gnueabihf/"
```

## sources/meta-dominion/conf/layer.conf
```bitbake
# We might have a conf and classes directory, append to BBPATH
BBPATH .= ":${LAYERDIR}"

# We have a recipes directory, add to BBFILES
BBFILES += "${LAYERDIR}/recipes*/*/*.bb ${LAYERDIR}/recipes*/*/*.bbappend"

BBFILE_COLLECTIONS += "meta-dominion"
BBFILE_PATTERN_meta-dominion := "^${LAYERDIR}/"
BBFILE_PRIORITY_meta-dominion = "8"
```

## sources/meta-dominion/conf/machine/beast.conf
```bitbake
#@TYPE: Machine
#@NAME: common_pc
#@DESCRIPTION: Machine configuration for running a common x86

PREFERRED_PROVIDER_virtual/xserver ?= "xserver-xorg"
PREFERRED_PROVIDER_virtual/libgl ?= "mesa"
PREFERRED_PROVIDER_virtual/libgles1 ?= "mesa"
PREFERRED_PROVIDER_virtual/libgles2 ?= "mesa"

require conf/machine/include/tune-corei7.inc

KERNEL_IMAGETYPE = "bzImage"

SERIAL_CONSOLE = "115200 ttyS0"

XSERVER = "xserver-xorg \
           ${@base_contains('DISTRO_FEATURES', 'opengl', 'mesa-driver-swrast', 'mesa-driver-radeon', d)} \
           xf86-input-evdev \
           xf86-video-ati"

MACHINE_FEATURES = "alsa bluetooth efi screen"

IMAGE_FSTYPES += "tar.xz hddimg"

PREFERRED_PROVIDER_virtual/kernel ?= "linux-dominion"

MACHINE_FEATURES += "x86"

MACHINE_ESSENTIAL_EXTRA_RDEPENDS += "gummiboot"
```

## sources/meta-dominion/conf/machine/dominion.conf
```bitbake
#@TYPE: Machine
#@NAME: common_pc
#@DESCRIPTION: Machine configuration for running a common x86

PREFERRED_PROVIDER_virtual/xserver ?= "xserver-xorg"
PREFERRED_PROVIDER_virtual/libgl ?= "mesa"
PREFERRED_PROVIDER_virtual/libgles1 ?= "mesa"
PREFERRED_PROVIDER_virtual/libgles2 ?= "mesa"

DEFAULTTUNE ?= "core2-64"
require conf/machine/include/tune-core2.inc

KERNEL_IMAGETYPE = "bzImage"

SERIAL_CONSOLE = "115200 ttyS0"

XSERVER = "xserver-xorg \
           ${@base_contains('DISTRO_FEATURES', 'opengl', 'mesa-driver-swrast', 'mesa-driver-i915 mesa-driver-i965', d)} \
           xf86-input-evdev \
           xf86-video-intel"

MACHINE_FEATURES = "alsa bluetooth screen"

IMAGE_FSTYPES += "tar.xz"

PREFERRED_PROVIDER_virtual/kernel ?= "linux-dominion"

MACHINE_FEATURES += "x86"
```
